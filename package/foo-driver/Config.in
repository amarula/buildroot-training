## package/foo-driver/Config.in
```kconfig
comment "foo-driver needs a Linux kernel to be built"
	depends on !BR2_LINUX_KERNEL

config BR2_PACKAGE_FOO_DRIVER
	bool "foo-driver"
	depends on BR2_aarch64 || BR2_arm
	depends on BR2_LINUX_KERNEL
	help
	  This package builds and installs the Linux kernel driver for foo reference
	  training
```
